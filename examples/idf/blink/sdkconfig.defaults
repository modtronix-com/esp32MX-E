## examples/idf/blink/sdkconfig.defaults
```kconfig
#
# Target and project specific settings
#

CONFIG_ESP32_PANIC_PRINT_HALT=y

CONFIG_ESPTOOLPY_FLASHMODE_DIO=y
CONFIG_ESPTOOLPY_FLASHMODE="dio"
CONFIG_ESPTOOLPY_FLASHFREQ_40M=y
CONFIG_ESPTOOLPY_FLASHFREQ="40m"
CONFIG_ESPTOOLPY_FLASHSIZE_4MB=y
CONFIG_ESPTOOLPY_FLASHSIZE="4MB"

CONFIG_ESP32_DEFAULT_CPU_FREQ_240=y
# CONFIG_ESP32_DEFAULT_CPU_FREQ_160 is not set
CONFIG_ESP32_DEFAULT_CPU_FREQ_MHZ=240
CONFIG_FREERTOS_HZ=1000
```

## examples/idf/ethernet/main/Kconfig.projbuild
```kconfig
menu "Example Configuration"

    config ESP32MX_LED_GPIO
        int "LED GPIO number"
        default 5
        help
            Set the GPIO number used for the LED.
            Set to -1 to disable LED on a GPIO.
            Set to 99 to use the LED on the I2C bus IO Expander.
endmenu
```

## examples/idf/ethernet/sdkconfig.defaults
```kconfig
#
# Target and project specific settings
#

CONFIG_LWIP_LOCAL_HOSTNAME="modtronix"

CONFIG_ESP32_PANIC_PRINT_HALT=y

CONFIG_ESPTOOLPY_FLASHMODE_DIO=y
CONFIG_ESPTOOLPY_FLASHMODE="dio"
CONFIG_ESPTOOLPY_FLASHFREQ_40M=y
CONFIG_ESPTOOLPY_FLASHFREQ="40m"
CONFIG_ESPTOOLPY_FLASHSIZE_4MB=y
CONFIG_ESPTOOLPY_FLASHSIZE="4MB"

CONFIG_ESPTOOLPY_MONITOR_BAUD_115200B=y
CONFIG_ESPTOOLPY_MONITOR_BAUD_OTHER_VAL=115200
CONFIG_ESPTOOLPY_MONITOR_BAUD=115200

# CONFIG_ESP32_REV_MIN_0=y
CONFIG_ESP32_REV_MIN_1=y
# CONFIG_ESP32_REV_MIN=0
CONFIG_ESP32_REV_MIN=1

CONFIG_ESP32_DEFAULT_CPU_FREQ_240=y
# CONFIG_ESP32_DEFAULT_CPU_FREQ_160 is not set
CONFIG_ESP32_DEFAULT_CPU_FREQ_MHZ=240
CONFIG_FREERTOS_HZ=1000

CONFIG_ETH_USE_ESP32_EMAC=y
CONFIG_ETH_PHY_INTERFACE_RMII=y
CONFIG_ETH_RMII_CLK_OUTPUT=y
CONFIG_ETH_RMII_CLK_OUTPUT_GPIO0=y
CONFIG_ETH_DMA_BUFFER_SIZE=512
CONFIG_ETH_DMA_RX_BUFFER_NUM=10
CONFIG_ETH_DMA_TX_BUFFER_NUM=10

CONFIG_ESP32MX_LED_GPIO=5
```
